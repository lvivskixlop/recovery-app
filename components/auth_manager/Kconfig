## components/auth_manager/Kconfig
```kconfig
menu "App Configuration"
    config APP_MASTER_PASSWORD
        string "Master Password"
        default "admin123"
        help
            The default password for the web interface. 
            Can be overridden by NVS.
endmenu
```

## components/wifi_manager/Kconfig
```kconfig
menu "WiFi Manager Configuration"

    config WIFI_SSID
        string "WiFi SSID"
        default "ssid"
        help
            The SSID (network name) for the WiFi station.

    config WIFI_PASSWORD
        string "WiFi Password"
        default "password"
        help
            The password for the WiFi station.

endmenu
```
